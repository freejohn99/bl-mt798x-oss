// SPDX-License-Identifier: GPL-2.0-or-later OR MIT

/dts-v1/;
#include "mt7981-cmcc-rax3000m.dts"

/ {
	model = "CMCC RAX3000Me (SPI-NAND DDR3)";
	compatible = "cmcc,rax3000me", "mediatek,mt7981";

	config {
		environment {
			bootargs = "root=/dev/fit0 rootwait";
			bootconf = "config-1#mt7981b-cmcc-rax3000m-nand";
		};
	};
};

&eth {
	mediatek,switch = "auto";
};
